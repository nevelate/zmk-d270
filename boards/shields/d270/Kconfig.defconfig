## boards/shields/d270/Kconfig.defconfig
```kconfig
if SHIELD_D270

config ZMK_KEYBOARD_NAME
    default "D270"

config I2C
	default y

config GPIO_MCP230XX
	default y

config BT_CTLR
	default BT

endif # SHIELD_D270
```
